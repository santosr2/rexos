## packaging/buildroot/Config.in
```kconfig
# RexOS Buildroot Configuration

menu "RexOS packages"

source "$BR2_EXTERNAL_REXOS_PATH/package/rexos-core/Config.in"
source "$BR2_EXTERNAL_REXOS_PATH/package/rexos-launcher/Config.in"
source "$BR2_EXTERNAL_REXOS_PATH/package/rexos-bridge/Config.in"

endmenu
```

## packaging/buildroot/configs/rexos_rg353_defconfig
```kconfig
# RexOS Buildroot Configuration for Anbernic RG353 Series
# Target: Rockchip RK3566 (Cortex-A55 quad-core)

# Architecture
BR2_aarch64=y
BR2_cortex_a55=y
BR2_ARM_FPU_NEON_FP_ARMV8=y

# Toolchain
BR2_TOOLCHAIN_BUILDROOT_GLIBC=y
BR2_TOOLCHAIN_BUILDROOT_CXX=y
BR2_GCC_VERSION_13_X=y
BR2_BINUTILS_VERSION_2_41_X=y
BR2_TOOLCHAIN_BUILDROOT_LOCALE=y

# Build options
BR2_CCACHE=y
BR2_OPTIMIZE_2=y
BR2_SSP_NONE=y

# Kernel
BR2_LINUX_KERNEL=y
BR2_LINUX_KERNEL_CUSTOM_GIT=y
BR2_LINUX_KERNEL_CUSTOM_REPO_URL="https://github.com/rockchip-linux/kernel.git"
BR2_LINUX_KERNEL_CUSTOM_REPO_VERSION="develop-5.10"
BR2_LINUX_KERNEL_USE_CUSTOM_CONFIG=y
BR2_LINUX_KERNEL_CUSTOM_CONFIG_FILE="$(BR2_EXTERNAL_REXOS_PATH)/board/rg353/linux.config"
BR2_LINUX_KERNEL_DTS_SUPPORT=y
# Device tree - use variant-specific DTS from board/rg353/dts/
# Available: rk3566-anbernic-rg353p.dts, rk3566-anbernic-rg353ps.dts
# Default: RG353PS (single analog stick, eMMC)
BR2_LINUX_KERNEL_CUSTOM_DTS_PATH="$(BR2_EXTERNAL_REXOS_PATH)/board/rg353/dts/rk3566-anbernic-rg353ps.dts"
BR2_LINUX_KERNEL_INSTALL_TARGET=y
BR2_LINUX_KERNEL_NEEDS_HOST_OPENSSL=y

# System
BR2_INIT_NONE=y
BR2_ROOTFS_DEVICE_CREATION_DYNAMIC_EUDEV=y
BR2_TARGET_GENERIC_HOSTNAME="rexos"
BR2_TARGET_GENERIC_ISSUE="Welcome to RexOS"
BR2_TARGET_GENERIC_GETTY=n
BR2_SYSTEM_BIN_SH_BUSYBOX=y
BR2_TARGET_TZ_INFO=y
BR2_TARGET_LOCALTIME="UTC"

# Filesystem
BR2_TARGET_ROOTFS_SQUASHFS=y
BR2_TARGET_ROOTFS_SQUASHFS_XZ=y
BR2_TARGET_ROOTFS_EXT2=y
BR2_TARGET_ROOTFS_EXT2_4=y
BR2_TARGET_ROOTFS_EXT2_SIZE="256M"

# Bootloader
BR2_TARGET_UBOOT=y
BR2_TARGET_UBOOT_BUILD_SYSTEM_KCONFIG=y
BR2_TARGET_UBOOT_CUSTOM_GIT=y
BR2_TARGET_UBOOT_CUSTOM_REPO_URL="https://github.com/rockchip-linux/u-boot.git"
BR2_TARGET_UBOOT_CUSTOM_REPO_VERSION="next-dev"
BR2_TARGET_UBOOT_BOARD_DEFCONFIG="evb-rk3566"
BR2_TARGET_UBOOT_NEEDS_DTC=y
BR2_TARGET_UBOOT_NEEDS_PYLIBFDT=y
BR2_TARGET_UBOOT_FORMAT_BIN=y

# Host tools
BR2_PACKAGE_HOST_DOSFSTOOLS=y
BR2_PACKAGE_HOST_E2FSPROGS=y
BR2_PACKAGE_HOST_GENIMAGE=y
BR2_PACKAGE_HOST_MTOOLS=y
BR2_PACKAGE_HOST_UBOOT_TOOLS=y
BR2_PACKAGE_HOST_RUSTC=y

# BusyBox
BR2_PACKAGE_BUSYBOX=y
BR2_PACKAGE_BUSYBOX_CONFIG="$(BR2_EXTERNAL_REXOS_PATH)/board/rg353/busybox.config"

# Core packages
BR2_PACKAGE_ALSA_LIB=y
BR2_PACKAGE_ALSA_UTILS=y
BR2_PACKAGE_ALSA_UTILS_AMIXER=y
BR2_PACKAGE_ALSA_UTILS_APLAY=y

# Graphics
BR2_PACKAGE_MESA3D=y
BR2_PACKAGE_MESA3D_GALLIUM_DRIVER_PANFROST=y
BR2_PACKAGE_MESA3D_OPENGL_ES=y
BR2_PACKAGE_LIBDRM=y

# SDL2
BR2_PACKAGE_SDL2=y
BR2_PACKAGE_SDL2_KMSDRM=y
BR2_PACKAGE_SDL2_OPENGLES=y
BR2_PACKAGE_SDL2_ALSA=y

# Input
BR2_PACKAGE_LIBINPUT=y
BR2_PACKAGE_EUDEV=y
BR2_PACKAGE_EUDEV_RULES_GEN=y

# Network (for WiFi)
BR2_PACKAGE_WPA_SUPPLICANT=y
BR2_PACKAGE_WPA_SUPPLICANT_NL80211=y
BR2_PACKAGE_WIRELESS_TOOLS=y
BR2_PACKAGE_IW=y
BR2_PACKAGE_BLUEZ5_UTILS=y
BR2_PACKAGE_BLUEZ5_UTILS_CLIENT=y

# RetroArch
BR2_PACKAGE_RETROARCH=y
BR2_PACKAGE_RETROARCH_MENU_OZONE=y
BR2_PACKAGE_RETROARCH_ASSETS=y

# RexOS packages
BR2_PACKAGE_REXOS_CORE=y
BR2_PACKAGE_REXOS_LAUNCHER=y
BR2_PACKAGE_REXOS_BRIDGE=y
BR2_PACKAGE_LIBRETRO_CORES=y

# Debugging (disable for release)
# BR2_ENABLE_DEBUG=y
# BR2_PACKAGE_GDB=y
# BR2_PACKAGE_STRACE=y
```

## packaging/buildroot/package/libretro-cores/Config.in
```kconfig
config BR2_PACKAGE_LIBRETRO_CORES
	bool "libretro-cores"
	depends on BR2_PACKAGE_RETROARCH
	help
	  Essential libretro cores for RexOS gaming OS.
	  Includes cores for popular retro gaming systems.

	  https://www.libretro.com/

if BR2_PACKAGE_LIBRETRO_CORES

config BR2_PACKAGE_LIBRETRO_CORES_MGBA
	bool "mGBA (GBA)"
	default y
	help
	  Game Boy Advance emulator core.

config BR2_PACKAGE_LIBRETRO_CORES_GAMBATTE
	bool "Gambatte (GB/GBC)"
	default y
	help
	  Game Boy / Game Boy Color emulator core.

config BR2_PACKAGE_LIBRETRO_CORES_SNES9X
	bool "SNES9x (SNES)"
	default y
	help
	  Super Nintendo emulator core.

config BR2_PACKAGE_LIBRETRO_CORES_NESTOPIA
	bool "Nestopia (NES)"
	default y
	help
	  Nintendo Entertainment System emulator core.

config BR2_PACKAGE_LIBRETRO_CORES_GENESIS_PLUS_GX
	bool "Genesis Plus GX (Sega)"
	default y
	help
	  Sega Genesis/Mega Drive, Master System, Game Gear core.

config BR2_PACKAGE_LIBRETRO_CORES_PCSX_REARMED
	bool "PCSX ReARMed (PlayStation)"
	default y
	help
	  PlayStation emulator optimized for ARM devices.

config BR2_PACKAGE_LIBRETRO_CORES_MUPEN64PLUS_NEXT
	bool "Mupen64Plus-Next (N64)"
	default y
	depends on BR2_aarch64 || BR2_i386 || BR2_x86_64
	help
	  Nintendo 64 emulator core.
	  Requires 64-bit ARM or x86 architecture.

config BR2_PACKAGE_LIBRETRO_CORES_DESMUME
	bool "DeSmuME (NDS)"
	default y
	help
	  Nintendo DS emulator core.

config BR2_PACKAGE_LIBRETRO_CORES_BEETLE_PCE
	bool "Beetle PCE (PC Engine)"
	default y
	help
	  PC Engine / TurboGrafx-16 emulator core.

config BR2_PACKAGE_LIBRETRO_CORES_FBNEO
	bool "FBNeo (Arcade)"
	default y
	help
	  Arcade emulator for CPS1, CPS2, CPS3, Neo Geo, and more.

config BR2_PACKAGE_LIBRETRO_CORES_PPSSPP
	bool "PPSSPP (PSP)"
	default y
	depends on BR2_aarch64 || BR2_i386 || BR2_x86_64
	help
	  PlayStation Portable emulator core.
	  Requires 64-bit ARM or x86 architecture.

config BR2_PACKAGE_LIBRETRO_CORES_FLYCAST
	bool "Flycast (Dreamcast)"
	default n
	depends on BR2_aarch64 || BR2_i386 || BR2_x86_64
	help
	  Sega Dreamcast emulator core.
	  Resource intensive - disabled by default.

config BR2_PACKAGE_LIBRETRO_CORES_PICODRIVE
	bool "PicoDrive (32X)"
	default y
	help
	  Sega 32X emulator core.

config BR2_PACKAGE_LIBRETRO_CORES_FCEUMM
	bool "FCEUmm (NES alternate)"
	default n
	help
	  Alternative NES emulator with more accuracy options.

endif
```

## packaging/buildroot/package/rexos-bridge/Config.in
```kconfig
config BR2_PACKAGE_REXOS_BRIDGE
	bool "rexos-bridge"
	help
	  RexOS C emulator bridge library for RetroArch integration.

	  https://github.com/santosr2/rexos
```

## packaging/buildroot/package/rexos-core/Config.in
```kconfig
config BR2_PACKAGE_REXOS_CORE
	bool "rexos-core"
	depends on BR2_PACKAGE_HOST_RUSTC
	help
	  RexOS core system components including HAL, storage,
	  config, and service modules.

	  https://github.com/santosr2/rexos
```

## packaging/buildroot/package/rexos-launcher/Config.in
```kconfig
config BR2_PACKAGE_REXOS_LAUNCHER
	bool "rexos-launcher"
	select BR2_PACKAGE_REXOS_CORE
	help
	  RexOS TUI game launcher application.

	  https://github.com/santosr2/rexos
```
